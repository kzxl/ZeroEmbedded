# STM32F401 register map
File version: 1.0
ARM Cortex-M4 Microcontroller with FPU
Registers are 32-bit, access not given, no defined reset value unless marked. A register's access mark holds for its fields unless they carry their own. Offsets are from the block's base; lines under a group give offsets from that group; [hi:lo] are bit positions; {n}, {i} and the like mark numbered series; 'fields as' and 'values as' point back to an identical list; <NAME> marks a mode.

## Memory map
0x40011000 USART1 — Universal synchronous asynchronous receiver transmitter
0x40020000 GPIOA — General-purpose I/O Port A

## GPIOA — General-purpose I/O Port A
Base 0x40020000
0x00 MODER — GPIO port mode register
0x04 OTYPER — GPIO port output type register
0x08 OSPEEDR — GPIO port output speed register
0x0C PUPDR — GPIO port pull-up/pull-down register
0x10 IDR — GPIO port input data register
0x14 ODR — GPIO port output data register
0x18 BSRR — GPIO port bit set/reset register

## USART1 — Universal synchronous asynchronous receiver transmitter
Base 0x40011000
0x00 SR — Status register
0x04 DR — Data register
0x08 BRR — Baud rate register
0x0C CR1 — Control register 1
